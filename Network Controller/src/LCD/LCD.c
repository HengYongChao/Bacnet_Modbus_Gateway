#include "reg80390.h"
#include "../LCD/lcd.h"
#include  <intrins.h> 
#include "system.h"
#include <string.h>
#include <ctype.h>  


unsigned char const code aby_Char_Table[10] = {'0','1','2','3','4','5','6','7','8','9'};

/*(0) !(1) "(2) #(3) $(4) %(5) &(6) '(7) ((8) )(9) *(10) +(11) ,(12) -(13) .(14) /(15)
 0(16) 1(17) 2(18) 3(19) 4(20) 5(21) 6(22) 7(23) 8(24) 9(25) :(26) ;(27) <(28) =(29) >(30) ?(31)
 @(32) A(33) B(34) C(35) D(36) E(37) F(38) G(39) H(40) I(41) J(42) K(43) L(44) M(45) N(46) O(47)
 P(48) Q(49) R(50) S(51) T(52) U(53) V(54) W(55) X(56) Y(57) Z(58) [(59) \(60) ](61) ^(62) _(63)
 `(64) a(65) b(66) c(67) d(68) e(69) f(70) g(71) h(72) i(73) j(74) k(75) l(76) m(77) n(78) o(79)
 p(80) q(81) r(82) s(83) t(84) u(85) v(86) w(87) x(88) y(89) z(90) {(91) |(92) }(93) ~(94) |(95)*/



unsigned char const code nAsciiDot[96][2][6] =  {

{0x00,0x00,0x00,0x00,0x00,0x00,0x00,0x00,0x00,0x00,0x00,0x00},/*" ",0*/

{0x00,0x00,0xF8,0x00,0x00,0x00,0x00,0x00,0x33,0x00,0x00,0x00},/*"!",1*/
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{0x00,0x00,0x80,0x7E,0x02,0x00,0x00,0x00,0x00,0x3F,0x40,0x00},/*"{",91*/

//{0x00,0x00,0x00,0xFF,0x00,0x00,0x00,0x00,0x00,0xFF,0x00,0x00},/*"|",92*/
{0x1C,0x22,0x1C,0xC0,0x40,0x40,0x00,0x00,0x00,0x3F,0x02,0x02},/*"δ�����ļ�",DEG AND F*/

//{0x00,0x02,0x7E,0x80,0x00,0x00,0x00,0x40,0x3F,0x00,0x00,0x00},/*"}",93*/
{0xF8,0xF0,0xE0,0xC0,0x80,0x00,0x0F,0x07,0x03,0x01,0x00,0x00},/*"δ�����ļ�",0 */

//{0x06,0x01,0x02,0x04,0x04,0x03,0x00,0x00,0x00,0x00,0x00,0x00},/*"~",94*/ 
{0x1C,0x22,0x1C,0x80,0x40,0x40,0x00,0x00,0x00,0x1F,0x20,0x20},/*"δ�����ļ�",DEG AND C */

{0x00,0x00,0x00,0xFF,0x00,0x00,0x00,0x00,0x00,0xFF,0x00,0x00},/*"|",95*/



};




sbit CS = P1^4;
sbit RESET = P1^6;
sbit A0 = P1^5;
sbit CLK = P1^3;
sbit DATA = P1^2;

sbit backlight = P1^7;





void Lcd_Write_Byte(char num) //from high to low
{
	char data i;
	CS = 0;//Lcd_Set(CS_LOW);
	_nop_();
	A0 = 1;//Lcd_Set(A0_HIGH);
	_nop_();	
	for(i = 0;i < 8;i++)
	{
		if(num & 0x80)	DATA = 1;//	Lcd_Set(DATA_HIGH);
     	else       	DATA = 0;	//Lcd_Set(DATA_LOW);
		
		_nop_();	
     	CLK = 0;//Lcd_Set(CLK_LOW);
		_nop_();
		CLK = 1;//Lcd_Set(CLK_HIGH);
		_nop_();

     	num <<= 1;	
	}
	_nop_();
	
	CS = 1;//Lcd_Set(CS_HIGH);//
	DATA = 1;
	_nop_();
}


void Lcd_Write_Command(char command) //from high to low
{
	char data i;
	CS = 0;//Lcd_Set(CS_LOW);//
	_nop_();
	A0 = 0;//Lcd_Set(A0_LOW);//
	_nop_();	
	for(i = 0;i < 8;i++)
	{
		if(command & 0x80)	DATA = 1;//Lcd_Set(DATA_HIGH);
     		else       		DATA = 0;//Lcd_Set(DATA_LOW);//
			
		_nop_();
     	CLK = 0;//Lcd_Set(CLK_LOW);//
		_nop_();

		CLK = 1;//Lcd_Set(CLK_HIGH);//
		_nop_();

     	command <<= 1;
	}
	_nop_();
	CS = 1;//Lcd_Set(CS_HIGH);//	
	DATA = 1;
	_nop_();
}


void Lcd_Write_Char(char row,char line,char num,char mode) // row: 0 - 4 , line: 0 - 21
{
	char data loop; 
	char data index = num - ' ';
		
	Lcd_Set_X_Addr((line + 1) * 6);
	Lcd_Set_Y_Addr(row * 2);
	for(loop = 0;loop < 6;loop++) 
		if(mode == 1)	Lcd_Write_Byte(nAsciiDot[index][0][loop]);
		else  Lcd_Write_Byte(~nAsciiDot[index][0][loop]);
	Lcd_Set_X_Addr((line + 1) * 6);
	Lcd_Set_Y_Addr(row * 2+1);
	for(loop = 0;loop < 6;loop++) 
		if(mode == 1)	Lcd_Write_Byte(nAsciiDot[index][1][loop]);
		else Lcd_Write_Byte(~nAsciiDot[index][1][loop]);

}


void Lcd_Set_Fuction(char mode)
{
	char data fuction;
	fuction = 0x38 + mode;//0x20 + mode;
	Lcd_Write_Command(fuction);
}

void Lcd_Set_Y_Addr(char page)// 0 1 0 0        page 0 - 9
{
	char data addr;
	Lcd_Set_Fuction(0);
	addr = 0x40 + page;
	Lcd_Write_Command(addr);
}

void Lcd_Set_X_Addr(char line)// 1 1 1 0/1        page 0 - 129
{
	char data addr;
	char data line_low;
	char data line_high;
	Lcd_Set_Fuction(0);
	line_low = line & 0x0f;
	line = line >> 4;
	line_high = line; 
	addr = 0xe0 + line_low; //low
	Lcd_Write_Command(addr);
	addr = 0xf0 + line_high; //high
	Lcd_Write_Command(addr);
}


void lcdreset(void)	   /* reset lcd before grogramming */
{
	RESET = 0;
}

void Display_reboot(void)
{

	Lcd_Show_String(2,5,"Reboot...",1,9);
}




void Lcd_Initial(void)
{
	RESET = 0;
	delay_us(100);
	RESET = 1;
	delay_us(10);

	
	Lcd_Set_Fuction(1); // 0x21	
	delay_us(10);
	Lcd_Write_Command(CMD_SET_BIAS);delay_us(10);	
	Lcd_Write_Command(CMD_SET_V0);	delay_us(10);
	Lcd_Write_Command(CMD_DISPLAY_CONFIG);delay_us(10);
	
	Lcd_Set_Fuction(0); // 0x20
	delay_us(10);
	Lcd_Write_Command(CMD_SET_V0Range_HIGH);    
	Lcd_Write_Command(CMD_DISPLAT_NORMAL);
//	Lcd_Write_Command(CMD_DISPLAY_INVERSE);
	Lcd_Set_X_Addr(0);  //0xf0 0xe0
	Lcd_Set_Y_Addr(0);  //0x40
	

	delay_us(10);
	Lcd_All_Off();

	backlight = 0;
	
}



void Lcd_Show_String(char pos_x,char pos_y,char* str,unsigned char mode,unsigned char length) // pos_x: 0 - 4 , pos_y: 0 - 15
{
	char data loop = 0;
	char data by_x,by_y;
	unsigned char temp = 0;
	char tempstr[21];

	for(loop = 0;loop < 21;loop++)	 tempstr[21] = ' ';

	by_x = pos_x;
	by_y = pos_y;
		
	for(loop = 0;loop < strlen(str);loop++)
	{
		if(mode & 0x80)	tempstr[loop] = (char)toupper(str[loop]);
		else tempstr[loop] = str[loop];
	}
	tempstr[loop] = '\0';

	if(length & 0x80) 
	{
		for(loop = 0;loop < length - 0x80;loop++)
		{
			if(temp == 0)
			{
				if(*(tempstr + loop) != '\0')	Lcd_Write_Char(by_x,by_y,*(tempstr + loop),mode & 0x7f);
				else  {temp = loop; Lcd_Write_Char(by_x,by_y,' ',mode & 0x7f);}
			}
			else
			{
				Lcd_Write_Char(by_x,by_y,' ',mode & 0x7f);
			}
			by_y++;		
		}
	
	}
	else
	{
		loop = 0;
		while(*(tempstr + loop) != '\0')
		{		
			/*Lcd_Write_Char(by_x,by_y,*(str + loop),mode);	
			by_y++;
			if(by_y >= 21)
			{
				by_y = 0;
				by_x ++;
				if(by_x >= 5)	by_x = 0;
			}*/
			if(by_y < 21) 
			{
				Lcd_Write_Char(by_x,by_y,*(tempstr + loop),mode & 0x7f);	
				by_y++;
			}
			loop ++;		
		}
	}	
}



void Lcd_Show_Data(char pos_x,char pos_y,unsigned int number,char dot,char mode) //,char div, bool signed)
{
	char data loop = 0;
	char data num[5];
	char data length;
	char data by_x,by_y;

	by_x = pos_x;
	by_y = pos_y;	

	//number = number / div;

	if(number >= 1000)	length = 4;
	else if(number >= 100)	length = 3;
	else if(number >= 10)	length = 2;
	else length = 1;

	if((length > 1) && (dot != 0)) 
	{
		length ++;	
		num[dot] = '.';
		num[4] = number / 1000; 	number = number % 1000;
		switch(dot)
		{
			case 3:
					num[2] = number / 100; 		number = number % 100;
					num[1] = number / 10; 		number = number % 10;
					num[0] = number;
					break;
			case 2:
					num[3] = number / 100; 		number = number % 100;
					num[1] = number / 10; 		number = number % 10;
					num[0] = number;
					break;
			case 1:
					num[3] = number / 100; 		number = number % 100;
					num[2] = number / 10; 		number = number % 10;
					num[0] = number;
					break;
		}

	}

	else
	{
		num[3] = number / 1000; 	number = number % 1000;
		num[2] = number / 100; 		number = number % 100;
		num[1] = number / 10; 		number = number % 10;
		num[0] = number;

	}	


	for(loop = length - 1;loop >= 0;loop--)
	{
		if(num[loop] == '.')	Lcd_Write_Char(by_x,by_y,'.',mode);
		else
		Lcd_Write_Char(by_x,by_y,aby_Char_Table[num[loop]],mode);
		by_y ++;
		if(by_y >= 21)
		{
			by_y = 0;
			by_x ++;
			if(by_x >= 5)	by_x = 0;
		}
	}
	for(loop = length;loop < length + 4;loop++)
	{
		Lcd_Write_Char(by_x,by_y,' ',mode);
		by_y ++;
	}
}


void Lcd_All_Off(void)
{
	unsigned int data i;
	
	for(i = 0;i < 130*80;i++)	
	{
		Lcd_Write_Byte(0x00);
	}
}




void Lcd_show_for_32bit(char pos_x,char pos_y,unsigned long number,char mode) //,char div, bool signed)
{
	char data loop = 0;
	char data num[11];
	char data length;
	char data by_x,by_y;

	by_x = pos_x;
	by_y = pos_y;	

	//number = number / div;

	if	   (number >= 1000000000)	length = 10;
	else if(number >= 100000000)	length = 9;
	else if(number >= 10000000)		length = 8;
	else if(number >= 1000000)		length = 7;
	else if(number >= 100000)		length = 6;
	else if(number >= 10000)		length = 5;
	else if(number >= 1000)			length = 4;
	else if(number >= 100)			length = 3;
	else if(number >= 10)			length = 2;
	else 							length = 1;

//	num[10] = number/ 10000000000; 		number = number % 10000000000;
	num[9] = number / 1000000000; 		number = number % 1000000000;
	num[8] = number / 100000000; 		number = number % 100000000;
	num[7] = number / 10000000; 		number = number % 10000000;
	num[6] = number / 1000000; 			number = number % 1000000;
	num[5] = number / 100000; 			number = number % 100000;					
	num[4] = number / 10000; 			number = number % 10000;
	num[3] = number / 1000; 			number = number % 1000;
	num[2] = number / 100; 				number = number % 100;
	num[1] = number / 10; 				number = number % 10;
	num[0] = number;



	for(loop = length - 1;loop >= 0;loop--)
	{
		if(num[loop] == '.')	Lcd_Write_Char(by_x,by_y,'.',mode);
		else
		Lcd_Write_Char(by_x,by_y,aby_Char_Table[num[loop]],mode);
		by_y ++;
		if(by_y >= 21)
		{
			by_y = 0;
			by_x ++;
			if(by_x >= 5)	by_x = 0;
		}
	}
	for(loop = length;loop < length + 4;loop++)
	{
		Lcd_Write_Char(by_x,by_y,' ',mode);
		by_y ++;
	}
}


